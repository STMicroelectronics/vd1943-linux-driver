// SPDX-License-Identifier: GPL-2.0-only
// Definitions for VD56G3 camera module on VC I2C bus

/dts-v1/;
/plugin/;

/include/ "vd1943_vd5943-overlay.dtsi"

/{
	compatible = "brcm,bcm2835";

	// Fragment numbers deliberately high to avoid conflicts with the
	// included vd1943_vd5943-overlay overlay file.

	fragment@101 {
		target = <&cam_node>;
		__overlay__ {
			compatible = "st,vd1943";
		};
	};
};
